## drivers/input/fingerprint/fpsensor/Kconfig
```kconfig
config CHIPONE_FINGERPRINT
	tristate "Chipone fingerprint driver"
	depends on INPUT_FINGERPRINT
	default n
	help
	  Say Y here to enable support for Fingerprint chip TEE driver

	  If unsure, say N.

	  To compile this driver as a module, choose M here.
```

## drivers/input/touchscreen/chipone-tddi/Kconfig
```kconfig
#
# Chipone Touchscreen driver configuration
#

config CASUARINA_TOUCHSCREEN_CHIPONE
        bool "Chipone Touchscreen"
		depends on I2C
		default n
		help
		  Say Y here if you have Chipone touch panel.
		  If unsure, say N.

config CASUARINA_TOUCHSCREEN_CHIPONE_DIRECTORY
    string "Chipone ts directory name"
    default "Chipone_touch"
    depends on CASUARINA_TOUCHSCREEN_CHIPONE
```

## drivers/platform/vsm/Kconfig
```kconfig
# Vsmart drivers

config MACH_VSMART
	bool "Vsmart board"
	depends on ARCH_QCOM
	help
	 Say Y here if you want to support Vsmart boards.
	 If unsure, say N.

config MACH_VSMART_CASUARINA
	bool "Vsmart Joy 3 / Joy 3+ NFC (casuarina)"
	depends on MACH_VSMART
	default n
	help
	 Vsmart Joy 3 / Joy 3+ NFC support.

config MACH_VSMART_PINE
	bool "Vsmart Joy 2+ (pine)"
	depends on MACH_VSMART
	default n
	help
	 Vsmart Joy 2+ support.
```
